## drivers/kernelsu/Kconfig
```kconfig
menu "KernelSU"

config KSU
	tristate "KernelSU function support"
	default y
	help
	  Enable kernel-level root privileges on Android System.
	  Requires CONFIG_KPROBES for kernel hooking support.
	  To compile as a module, choose M here: the
	  module will be called kernelsu.

config KSU_DEBUG
	bool "KernelSU debug mode"
	depends on KSU
	default n
	help
	  Enable KernelSU debug mode.

config KSU_DISABLE_MANAGER
	bool "Disable KernelSU manager integration"
	depends on KSU
	default n
	help
	  Disable manager APK detection and manager-specific handling.
	  Root will be used in place of manager-only functionality.

config KSU_DISABLE_POLICY
	bool "Disable KernelSU policy profiles"
	depends on KSU
	default n
	help
	  Disable per-app root/non-root profile customization.
	  Escalation will always use the default full root profile, and
	  non-root handling will follow the global umount policy only.

config KSU_ALLOWLIST_WORKAROUND
	bool "KernelSU allowlist workaround"
	depends on KSU
	default n
	help
	  Enable workaround for broken allowlist save

# For easier extern ifdef handling
config KSU_MANUAL_HOOK
	bool "KernelSU manual hook mode."
	depends on KSU && KSU != m
	default y if !KPROBES
	default n
	help
	  Enable manual hook support.

choice
	prompt "KernelSU dynamic hook mode"
	depends on KSU && !KSU_MANUAL_HOOK
	default KSU_KPROBES_HOOK

config KSU_KPROBES_HOOK
	bool "KernelSU tracepoint+kretprobe hook"
	depends on KRETPROBES && KPROBES && HAVE_SYSCALL_TRACEPOINTS
	help
	  Enable KPROBES, KRETPROBES and TRACEPOINT hook for KernelSU core.
	  This should not be used on kernel below 5.10.

config KSU_SYSCALL_TABLE_HOOK
	bool "KernelSU syscall table patching hook"
	depends on ARM64 || X86_64
	help
	  Patch sys_call_table entries directly to hook syscalls without
	  kprobes or tracepoints. Intended for non-GKI kernels where kprobes
	  are unavailable or non-functional.
	  Requires kernel >= 4.17 (pt_regs-based syscall ABI).

endchoice


config KSU_SUSFS
	bool "SUSFS support"
	depends on KSU
	default y
	help
	  Enable SUSFS (SU SuperFS) kernel side support.
	  This is the in-tree 4.14 port driven through the reboot(2)
	  supercall protocol, not the upstream 5.10+ LKM.

config KSU_SUSFS_SUS_PATH
	bool "SUSFS: hide paths (sus_path)"
	depends on KSU_SUSFS
	default y
	help
	  Hide registered paths from non-root app processes: the entry
	  disappears from getdents64 and lookups return -ENOENT.

config KSU_SUSFS_SUS_MOUNT
	bool "SUSFS: hide mounts (sus_mount)"
	depends on KSU_SUSFS
	default y
	help
	  Give mounts created from the KSU domain a private mnt_id range and
	  drop them from /proc/*/mounts, /proc/*/mountinfo and /proc/*/mountstats.

config KSU_SUSFS_SUS_KSTAT
	bool "SUSFS: fake file attributes (sus_kstat)"
	depends on KSU_SUSFS
	default y
	help
	  Report spoofed size/timestamps/dev/ino for registered paths to
	  non-root app processes (stat/statx and /proc/pid/maps).

config KSU_SUSFS_SPOOF_UNAME
	bool "SUSFS: spoof uname (release/version)"
	depends on KSU_SUSFS
	default y

config KSU_SUSFS_SPOOF_CMDLINE_OR_BOOTCONFIG
	bool "SUSFS: spoof /proc/cmdline"
	depends on KSU_SUSFS
	default y

config KSU_SUSFS_OPEN_REDIRECT
	bool "SUSFS: redirect open() of a path"
	depends on KSU_SUSFS
	default y

config KSU_SUSFS_ENABLE_LOG
	bool "SUSFS: enable logging"
	depends on KSU_SUSFS
	default y
	help
	  Allow susfs log output to be toggled at runtime.

endmenu
```
